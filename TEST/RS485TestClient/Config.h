#ifndef _CONFIG_H
#define _CONFIG_H
//--------------------------------------------------------------------------------------------------------------------------------------
#include <Arduino.h>
//--------------------------------------------------------------------------------------------------------------------------------------
#define CORE_HEADER1 0x50
#define CORE_HEADER2 0xED
#define CORE_HEADER3 0x9F
//--------------------------------------------------------------------------------------------------------------------------------------
typedef enum
{
  UnknownType,
  Temperature, // температура
  Luminosity, // освещённость
  Humidity, // температура и влажность
  DateTime, // дата и время
  DigitalPort, // состояние порта
  AnalogPort, // показания аналогового порта
  UserData, // пользовательские данные
  //TODO: Тут добавлять другие типы!!!
  
  
} CoreDataType;
//--------------------------------------------------------------------------------------------------------------------------------------
// типы пакетов, гоняющихся по транспортам
//--------------------------------------------------------------------------------------------------------------------------------------
enum
{
  CoreSensorData = 1, // пакет с показаниями датчика от какого либо устройства в системе
  CoreDataRequest = 2, // пакет с запросом информации по данным к модулю в системе
};
// общее описание пакета, гоняющегося по транспортам
//--------------------------------------------------------------------------------------------------------------------------------------
typedef struct
{
  // заголовок пакета
  byte header1;
  byte header2;
  byte header3;

  // идентификатор кластера
  byte clusterID;

  // идентификатор устройства, пославшего пакет
  byte deviceID;

  // тип пакета
  byte packetType;

  byte packetData[23]; // данные пакета, в зависимости от типа пакета
  

  // контрольная сумма
  byte crc; 
  
} CoreTransportPacket;
//--------------------------------------------------------------------------------------------------------------------------------------
// описание пакета данных запроса информации о кол-ве данных у модуля на шине (23 байта)
//--------------------------------------------------------------------------------------------------------------------------------------
typedef struct
{
  byte toDeviceID; // какому устройству предназначен запрос
  byte dataCount; // сколько у устройства записей с данными

  byte reserved[21]; // резерв
  
} CoreDataRequestPacket;
//--------------------------------------------------------------------------------------------------------------------------------------
// описание пакета данных с показаниями датчика, гоняющегося по транспортам (23 байта)
//--------------------------------------------------------------------------------------------------------------------------------------
typedef struct
{
  // имя датчика, максимум 10 символов, заканчивается '\0'
  char sensorName[11]; 

  // тип данных (температура, влажность, прочее)
  byte dataType;
    
  // длина данных
  byte dataLen;

  // данные, максимум 10 байт
  byte data[10];
  
} CoreSensorDataPacket;
//--------------------------------------------------------------------------------------------------------------------------------------
byte crc8(const byte *addr, byte len)
{
  byte crc = 0;
  while (len--) 
    {
    byte inbyte = *addr++;
    for (byte i = 8; i; i--)
      {
      byte mix = (crc ^ inbyte) & 0x01;
      crc >>= 1;
      if (mix) 
        crc ^= 0x8C;
      inbyte >>= 1;
      }  // end of for
    }  // end of while
  return crc;  
}
//--------------------------------------------------------------------------------------------------------------------------------------
#endif
